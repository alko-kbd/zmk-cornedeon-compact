## boards/shields/cornedeon_compact/Kconfig.defconfig
```kconfig
config ZMK_SPLIT
    default n

if SHIELD_CORNEDEON_COMPACT_CENTRAL

config ZMK_SPLIT_ROLE_CENTRAL
    default y

config ZMK_USB
    default y

endif  # CENTRAL
```

## boards/shields/cornedeon_compact/Kconfig.shield
```kconfig
config SHIELD_CORNEDEON_COMPACT_CENTRAL
    def_bool $(shields_list_contains,cornedeon_compact_central)
```
